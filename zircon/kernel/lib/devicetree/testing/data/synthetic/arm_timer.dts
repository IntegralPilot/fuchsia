// Copyright 2023 The Fuchsia Authors. All rights reserved.
// Use of this source code is governed by a BSD-style license that can be
// found in the LICENSE file.

/dts-v1/;

/ {
    interrupt-parent = <0x8001>;
    #size-cells = <0x02>;
    #address-cells = <0x02>;
    some-interrupt-controller {
        #address-cells = <0x02>;
        #size-cells = <0x02>;
        #interrupt-cells = <0x03>;
            compatible = "arm,gic-v3";
        phandle = <0x8001>;
        interrupt-controller;
    };
    timer {
        compatible = "arm,armv7-timer\0arm,armv8-timer";
        clock-frequency = <1234>;
        interrupts = <1 10 0xF08>,
                     <1 11 0xF08>,
                     <1 12 0xF08>,
                     <1 13 0xF08>;
    };
};