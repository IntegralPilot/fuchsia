// Copyright 2023 The Fuchsia Authors. All rights reserved.
// Use of this source code is governed by a BSD-style license that can be
// found in the LICENSE file.

/dts-v1/;

/ {
    interrupt-parent = <0x8001>;
    #size-cells = <0x02>;
    #address-cells = <0x02>;
    memory@40000000 {
        reg = <0x00 0x40000000 0x02 0x00>;
        device_type = "memory";
    };

    intc@8000000 {
        phandle = <0x8001>;
        interrupts = <0x01 0x09 0x04>;
        reg = <0x00 0x8000000 0x00 0x10000 0x00 0x8010000 0x00 0x10000 0x00 0x8030000 0x00 0x10000 0x00 0x8040000 0x00 0x10000>;
        compatible = "arm,cortex-a15-gic";
        ranges;
        #size-cells = <0x02>;
        #address-cells = <0x02>;
        interrupt-controller;
        #interrupt-cells = <0x03>;
    };
};
