// Copyright 2026 The Fuchsia Authors. All rights reserved.
// Use of this source code is governed by a BSD-style license that can be
// found in the LICENSE file.

/dts-v1/;
/ {
    #address-cells = <2>;
    #size-cells = <2>;
    chosen {
        #address-cells = <2>;
        #size-cells = <2>;
        ranges;
        framebuffer@103e1bf4000 {
            compatible = "simple-framebuffer";
            reg = <0x103 0xe1bf4000 0 0x20000>;
            width = <120>;
            height = <60>;
            stride = <512>;
            format = "bogus";
        };
    };
};
