// Copyright 2025 The Fuchsia Authors. All rights reserved.
// Use of this source code is governed by a BSD-style license that can be
// found in the LICENSE file.

/dts-v1/;

/ {
    interrupt-parent = <0x8001>;
    #size-cells = <0x01>;
    #address-cells = <0x01>;
    some-interrupt-controller {
        #address-cells = <0x02>;
        #size-cells = <0x02>;
        #interrupt-cells = <0x03>;
        compatible = "arm,gic-v3";
        phandle = <0x8001>;
        interrupt-controller;
    };
    timer@12340000 {
        #address-cells = <0x01>;
        #size-cells = <0x01>;
        ranges;
        compatible = "arm,armv7-timer-mem";
        reg = <0x12340000 0x1000>;
        phandle = <0x192>;
    };
};
