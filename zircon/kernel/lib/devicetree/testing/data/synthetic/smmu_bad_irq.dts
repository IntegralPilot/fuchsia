// Copyright 2026 The Fuchsia Authors. All rights reserved.
// Use of this source code is governed by a BSD-style license that can be
// found in the LICENSE file.

/dts-v1/;

// An SMMU configuration with a bad IRQ index.  We expect the bad IRQ to be
// replaced with "0" (invalid), but not removed from the array.
/ {
    interrupt-parent = <0x8001>;
    #address-cells = <0x01>;
    #size-cells = <0x01>;

    some-interrupt-controller {
      #interrupt-cells = <0x03>;
      compatible = "arm,gic-v3";
      phandle = <0x8001>;
      interrupt-controller;
    };

    test-smmu@4e54000 {
      compatible = "qcom,qsmmu-v500";
      reg = <0x4e54000 0x80000>;
      #global-interrupts = <0x01>;
      interrupts = <0x00 0x01 0x04
                    0x00 0x02 0x04
                    0x00 0xFFFFFFFF 0x04
                    0x00 0x04 0x04
                    0x00 0x05 0x04>;
    };
};

