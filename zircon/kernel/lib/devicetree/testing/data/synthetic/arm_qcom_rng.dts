  // Copyright 2025 The Fuchsia Authors. All rights reserved.
// Use of this source code is governed by a BSD-style license that can be
// found in the LICENSE file.

/dts-v1/;

/ {
    #size-cells = <0x02>;
    #address-cells = <0x02>;
    qrng@1234 {
        compatible = "qcom,msm-rng";
        reg = <0x0 0x1234 0x0 0x1000>;
    };
};