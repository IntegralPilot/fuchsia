// Copyright 2025 The Fuchsia Authors. All rights reserved.
// Use of this source code is governed by a BSD-style license that can be
// found in the LICENSE file.

/dts-v1/;

/ {
    #address-cells = <1>;
    #size-cells = <1>;
    chosen {
        bootargs = "   androidboot.serialno=foo-bar-baz   ";
    };
};