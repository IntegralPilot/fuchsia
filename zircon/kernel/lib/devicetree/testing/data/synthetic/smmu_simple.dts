// Copyright 2026 The Fuchsia Authors. All rights reserved.
// Use of this source code is governed by a BSD-style license that can be
// found in the LICENSE file.

/dts-v1/;

// An SMMU configuration which presents a rather standard configuration.
/ {
    interrupt-parent = <0x8001>;
    #address-cells = <0x01>;
    #size-cells = <0x01>;

    some-interrupt-controller {
      #interrupt-cells = <0x03>;
      compatible = "arm,gic-v3";
      phandle = <0x8001>;
      interrupt-controller;
    };

    test-smmu@4e54000 {
      compatible = "qcom,qsmmu-v500";
      reg = <0x4e54000 0x80000>;
      qcom,num-context-banks-override = <0x4>;
      qcom,num-smr-override = <0x8>;
      qcom,handoff-smrs = <0x420 0x02>;
      #global-interrupts = <0x01>;
      interrupts = <0x00 0x51 0x04 0x00 0x57 0x04 0x00 0x58 0x04 0x00 0x59 0x04 0x00 0x5a 0x04>;
    };
};
