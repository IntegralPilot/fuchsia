// Copyright 2024 The Fuchsia Authors. All rights reserved.
// Use of this source code is governed by a BSD-style license that can be
// found in the LICENSE file.

/dts-v1/;

/ {
    #size-cells = <0x01>;
    #address-cells = <0x01>;
    a {
        compatible = "foo";
    };
    b {
        #interrupt-cells=<0x02>;
        interrupt-controller;
        phandle=<0x01>;
    };
    qcom,wdt@f017000 {
        interrupt-parent=<0x01>;
        compatible = "qcom,msm-watchdog";
        reg = <0xf017000 0x1000>;
        reg-names = "wdt-base";
        interrupts = <0x00 0x03 0x04 0x00 0x04 0x04>;
        qcom,bark-time = <0x2af8>;
        qcom,pet-time = <0x2490>;
        qcom,ipi-ping;
        qcom,wakeup-enable;
    };
};
