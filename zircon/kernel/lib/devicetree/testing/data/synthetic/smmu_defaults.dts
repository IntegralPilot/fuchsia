// Copyright 2026 The Fuchsia Authors. All rights reserved.
// Use of this source code is governed by a BSD-style license that can be
// found in the LICENSE file.

/dts-v1/;

// An SMMU configuration which specifies nothing but the required MMIO base
// register address. All of the other fields in the ZBI structure should take on
// their default values.
/ {
    #address-cells = <0x01>;
    #size-cells = <0x01>;
    test-smmu@4e54000 {
      compatible = "qcom,qsmmu-v500";
      reg = <0x4e54000 0x80000>;
    };
};
