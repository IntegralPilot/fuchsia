// Copyright 2024 The Fuchsia Authors. All rights reserved.
// Use of this source code is governed by a BSD-style license that can be
// found in the LICENSE file
/dts-v1/;

/ {
	compatible = "fuchsia,test-dt";
	model = "test";
	#address-cells = <2>;
	#size-cells = <2>;

	canvas: canvas {
		compatible = "amlogic,canvas";
	};

	video-decoder {
		compatible = "video-decoder";
		amlogic,canvas = <&canvas>;
	};
};
