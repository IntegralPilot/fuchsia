// Copyright 2024 The Fuchsia Authors. All rights reserved.
// Use of this source code is governed by a BSD-style license that can be
// found in the LICENSE file
/dts-v1/;

/ {
	compatible = "fuchsia,test-dt";
	model = "test";
	#address-cells = <2>;
	#size-cells = <2>;

	gpu: gpu-controller {
		compatible = "board-x,gpu";
	};

	mali-controller {
		compatible = "board-x,mali-gpu";
		mali-gpu-parent = <&gpu>;
	};
};
