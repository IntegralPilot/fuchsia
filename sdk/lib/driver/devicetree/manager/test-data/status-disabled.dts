// Copyright 2023 The Fuchsia Authors. All rights reserved.
// Use of this source code is governed by a BSD-style license that can be
// found in the LICENSE file
/dts-v1/;

/ {
	compatible = "fuchsia,sample-dt";
	model = "test";
	#address-cells = <2>;
	#size-cells = <2>;

	status-okay-device {
		compatible = "status-okay-device";
		status = "okay";
	};

	status-disabled-device {
		compatible = "status-disabled-device";
		status = "disabled";
	};

	status-none-device {
		compatible = "status-none-device";
	};
};
