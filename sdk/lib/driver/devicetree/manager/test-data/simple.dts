// Copyright 2023 The Fuchsia Authors. All rights reserved.
// Use of this source code is governed by a BSD-style license that can be
// found in the LICENSE file
/dts-v1/;

/include/ "sdk/lib/driver/devicetree/manager/test-data/simple.dtsi"

/ {
	compatible = "fuchsia,sample-dt";
	model = "test";
	#address-cells = <2>;
	#size-cells = <2>;

	another-device {
		reference = <&label>;
	};
};
