/dts-v1/;

/ {
	#address-cells = <0x02>;
	#size-cells = <0x02>;
	compatible = "fuchsia,sample-dt";
	model = "test";

	another-device {
		reference = <0x01>;
	};

	example-device {
		compatible = "fuchsia,sample-device";
		phandle = <0x01>;
	};
};
