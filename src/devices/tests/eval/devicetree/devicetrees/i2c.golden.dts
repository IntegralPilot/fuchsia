/dts-v1/;

/ {
	#address-cells = <0x01>;
	#size-cells = <0x01>;

	test-i2c-bus@3000 {
		compatible = "fuchsia,test-i2c-bus";
		reg = <0x3000 0x100>;
		#address-cells = <0x01>;
		#size-cells = <0x00>;

		test-i2c@42 {
			compatible = "fuchsia,test-i2c-device";
			reg = <0x42>;
		};
	};
};
