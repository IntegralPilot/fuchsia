/dts-v1/;

/ {
	#address-cells = <0x01>;
	#size-cells = <0x01>;

	gpio@1000 {
		compatible = "fuchsia,gpio-controller";
		reg = <0x1000 0x100>;
		gpio-controller;
		#gpio-cells = <0x02>;
		interrupt-controller;
		#interrupt-cells = <0x02>;
		phandle = <0x01>;
	};

	test-gpio@2000 {
		compatible = "fuchsia,test-gpio-device";
		reg = <0x2000 0x100>;
		gpios = <0x01 0x05 0x00>;
		interrupts-extended = <0x01 0x02 0x01>;
	};
};
