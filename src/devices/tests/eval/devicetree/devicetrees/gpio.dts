// Copyright 2026 The Fuchsia Authors. All rights reserved.
// Use of this source code is governed by a BSD-style license that can be
// found in the LICENSE file.
/dts-v1/;

/ {
	#address-cells = <1>;
	#size-cells = <1>;

	gpio_controller: gpio@1000 {
		compatible = "fuchsia,gpio-controller";
		reg = <0x1000 0x100>;
		gpio-controller;
		#gpio-cells = <2>;
		interrupt-controller;
		#interrupt-cells = <2>;
	};

	test-gpio@2000 {
		compatible = "fuchsia,test-gpio-device";
		reg = <0x2000 0x100>;
		gpios = <&gpio_controller 5 0>;
		interrupts-extended = <&gpio_controller 2 1>;
	};
};
