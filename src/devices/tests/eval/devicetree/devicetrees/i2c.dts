// Copyright 2026 The Fuchsia Authors. All rights reserved.
// Use of this source code is governed by a BSD-style license that can be
// found in the LICENSE file.
/dts-v1/;

/ {
	#address-cells = <1>;
	#size-cells = <1>;

	test-i2c-bus@3000 {
		compatible = "fuchsia,test-i2c-bus";
		reg = <0x3000 0x100>;
		#address-cells = <1>;
		#size-cells = <0>;

		test-i2c@42 {
			compatible = "fuchsia,test-i2c-device";
			reg = <0x42>;
		};
	};
};
