/dts-v1/;

/ {
	#address-cells = <1>;
	#size-cells = <0>;

	devicetree-config-child {
		compatible = "devicetree-config-child";

		fuchsia,config {
			string_prop = "hello";
			int_prop = <0x12345678>;

			nested {
				prop = "world";
			};
		};
	};
};
