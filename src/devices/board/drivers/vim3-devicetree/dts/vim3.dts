// Copyright 2024 The Fuchsia Authors. All rights reserved.
// Use of this source code is governed by a BSD-style license that can be
// found in the LICENSE file.
/dts-v1/;

/include/ "vim3-power-config.dtsi"

/ {
	// Do not add any nodes to this file. This file is used only to coalasce all nodes.
	// Please add board specific nodes to khadas-vim3-board.dtsi.S
	// Power config related nodes and additions go into vim3-power-config.dtsi
	// A311D SOC specific nodes go into amlogic-a311d.dtsi.S
	// Meson G12 platform common nodes go into meson-g12-common.dtsi.S.
};
